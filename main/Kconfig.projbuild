## main/Kconfig.projbuild
```kconfig
menu "mrubyc-esp32 Configuration"
    config USE_ESP32_FIRMWAREFLASH
        bool "USE ESP32 Firmware Flash"
        default n

    config USE_ESP32_WIFI
        bool "USE ESP32 WIFI"
	default y

    config USE_ESP32_IBEACON
        bool "USE ESP32 iBeacon (with Bluetooth)"
        default n
		
    choice IBEACON_MODE
        bool "iBeacon Mode"
        default IBEACON_SENDER
        help
            Select the iBeacon Mode.

        config IBEACON_SENDER
            bool "iBeacon Sender Mode"
            help
                Select the iBeacon Sender Mode.

        config IBEACON_RECEIVER
            bool "iBeacon Receiver Mode"
            help
                Select the iBeacon Receiver Mode.
    endchoice

    config IBEACON_MODE
        int
        default 0 if IBEACON_SENDER
        default 1 if IBEACON_RECEIVER
	depends on USE_ESP32_IBEACON
	
endmenu
```
